## CMakeLists.txt
```
cmake_minimum_required(VERSION 3.20.0)
find_package(Zephyr REQUIRED HINTS $ENV{ZEPHYR_BASE})
project(claude_usage_display)

target_sources(app PRIVATE
	src/main.c
	src/proto.c
	src/msg_parse.c
	src/usage_view.c
	src/fmt.c
	src/cfg_store.c
	src/net_time.c
	src/ui_boot.c
	src/bootanim_dec.c
	src/bootclip.c
	src/ui_sleep.c
	src/sleep_gate.c
	src/upd_prompt.c
	src/upd_row.c
	src/upd_tap.c
	src/whatsnew.c
	src/logo_parse.c
	src/logo.c
	src/ui_settings.c
	src/ui_anim.c
	src/ui_slide.c
	src/ui_swipe.c
	src/backlight.c
	src/theme.c
	src/badges.c
	src/ui_badges.c
	src/ota_parse.c
	src/ota.c
	src/ui_touchfx.c
	src/usage_state.c
	src/usage_freshness.c
)

# Diagnostic only; CONFIG_BLINK_TOUCH_TRACE is off in release builds.
target_sources_ifdef(CONFIG_BLINK_TOUCH_TRACE app PRIVATE src/touch_trace.c)
```

## Kconfig
```
# Application Kconfig. Zephyr sources this in place of its own root, so the
# trailing `source "Kconfig.zephyr"` is mandatory -- without it every upstream
# symbol disappears.

menu "Blink"

config BLINK_TOUCH_TRACE
	bool "Touch trace diagnostic"
	depends on INPUT_XPT2046
	help
	  Record every XPT2046 report into a RAM ring and dump it as CSV over
	  the console when the finger lifts. Diagnostic only -- enable via
	  trace.conf, never in a release build.


config BLINK_PANEL_PILOT
	bool "Build for the two pilot (POC) display panels"
	help
	  The production batch and the two pilot boards carry different
	  display modules. Measured on hardware 2026-08-21, the production
	  panels differ three ways: they render mirrored, they are wired RGB
	  where the ILI9341 driver hardcodes BGR, and their backlight is far
	  brighter at the same PWM duty. The firmware compensates for all
	  three by default, because production is what ships.

	  Set this when building for one of the two pilot boards, which need
	  none of that compensation and would otherwise come out mirrored,
	  colour-swapped and dim. Enable it through pilot.conf:

	    west build -b esp32_devkitc/esp32/procpu . -- \
	      -DEXTRA_CONF_FILE=pilot.conf

	  Deliberately NOT derived from flash encryption. The pilots happen to
	  be the only fused boards today, so keying off FLASH_CRYPT_CNT would
	  work right now and then quietly break: production units get fused
	  before shipping, and the rule would build pilot firmware for them.

config BLINK_BL_SCALE_PCT
	int "Backlight duty as a percent of the nominal level"
	range 10 100
	default 100 if BLINK_PANEL_PILOT
	default 60
	help
	  Scales every brightness step, so that a given user-facing percent
	  means the same amount of light on either batch. Compared side by
	  side at an identical setting, the production panel had to be
	  stepped down before it matched a pilot, so it is scaled here rather
	  than by lowering the default level -- which would have shrunk the
	  usable 20..100 range instead of recentring it.

endmenu

source "Kconfig.zephyr"
```

## prj.conf
```kconfig
# --- Console / logging ---
CONFIG_PRINTK=y
CONFIG_LOG=y
CONFIG_CBPRINTF_FP_SUPPORT=y

# --- Console UART access for protocol I/O ---
CONFIG_SERIAL=y
CONFIG_UART_CONSOLE=y
CONFIG_CONSOLE=y

# Interrupt-driven RX. On a real UART (this board, unlike the C6's USB-CDC) the
# 128-byte FIFO holds ~11 ms at 115200 baud, so polling from the main loop drops
# bytes mid-line as soon as anything stalls it.
CONFIG_UART_INTERRUPT_DRIVEN=y
CONFIG_RING_BUFFER=y

# --- Board identity for the hello message ---
CONFIG_HWINFO=y

# --- Heap / stacks ---
CONFIG_MAIN_STACK_SIZE=8192
# A phone associating to the SoftAP is served by our custom DHCPv4 server (DNS +
# router options + unicast-OFFER ARP injection) which runs on the
# net_socket_service thread. Its 2400 B default stack overflowed on that path and
# corrupted kernel memory -> fatal fault in z_swap on the next context switch,
# crash-looping the board on every join (root cause pinned 2026-07-24 via
# STACK_SENTINEL, which named net_socket_service). 4096 B clears it with margin.
CONFIG_NET_SOCKETS_SERVICE_STACK_SIZE=4096
# Cheap insurance: turn a future stack overflow into a clean named reboot instead
# of silent memory corruption. THREAD_NAME makes the culprit legible in the dump.
CONFIG_THREAD_NAME=y
CONFIG_STACK_SENTINEL=y

# --- Display bring-up (CYD-T2 panel probe) ---
CONFIG_SPI=y
# Explicitly OFF, which is also the Kconfig default -- kept as a line rather
# than a deletion so nobody re-adds it for the reason we did.
#
# It was set on 2026-07-27 to "sleep on the transfer-complete interrupt instead
# of busy-polling". The driver does not do that. With it on, transceive() arms
# the interrupt and falls straight through to spi_context_release() --
# spi_esp32_spim.c has no spi_context_wait_for_completion() call, and
# CONFIG_SPI_ASYNC is off, so the spi_context_complete() the ISR performs only
# gives a semaphore nobody takes. Every synchronous transfer became
# fire-and-forget: XPT2046 read its RX buffer before the words landed (16
# averaged reads per touch report), and display_write() returned with DMA still
# reading the caller's strip.
#
# The busy-poll it was meant to remove survives either way -- the
# `while (!spi_hal_usr_is_done(hal))` spin is still there, just moved into the
# ISR. And that ISR is registered ESP_INTR_FLAG_IRAM while its CS teardown
# reaches gpio_esp32_port_clear_bits_raw in .flash.text, so it would fault if it
# fired during an NVS or OTA write, when the flash cache is down.
CONFIG_SPI_ESP32_INTERRUPT=n
CONFIG_GPIO=y
CONFIG_DISPLAY=y
CONFIG_MIPI_DBI=y
CONFIG_ILI9341=y
CONFIG_INPUT=y
CONFIG_INPUT_XPT2046=y

# --- LVGL ---
CONFIG_LVGL=y
CONFIG_LV_USE_LOG=y
CONFIG_LV_COLOR_DEPTH_16=y
# The ILI9341 takes big-endian RGB565 over SPI; the ESP32 is little-endian.
CONFIG_LV_COLOR_16_SWAP=y
# 32 KiB: gauge screen + settings overlay + confirm dialog coexist, and every
# redraw allocates transient draw tasks on top. 16 KiB ran dry there and LVGL
# NULL-derefed (no graceful malloc-failure path in lv_draw_add_task).
# 30720 (was 32768): 2 KB went to the enlarged net_socket_service stack, which
# shares dram1 with this pool. Still ~2x the 16 KB that once ran dry on the gauge
# screen, so ample headroom remains.
#
# 40960 since 1.7.0, and "ample headroom" above was measured wrong: with the
# settings panel built the pool stood at 23504 used / 7128 free, and drawing
# that panel ran it dry -- LVGL NULL-derefs a failed glyph buffer
# (lv_draw_label.c:610) -- once the badges row was the third row on it
# (bench board, 2026-10-14; the numbers are printed as "[mem] lvgl pool ...").
# dram1_0_seg, where this pool lives, measured 55% used (54536 of 96 KB) in the
# same build, so the 10 KB comes out of space that was genuinely free; the
# "dram1 nearly full" notes below are from an older Zephyr's layout.
CONFIG_LV_Z_MEM_POOL_SIZE=40960
# Live numbers for the pool above: the board prints them at the gauges, with
# settings open and with the Badges screen open ("[mem] lvgl pool ..."). Off,
# lvgl_heap_stats() writes nothing, and the first attempt at reading them
# printed whatever the stack held -- the settings panel's version string. A
# 30 KB pool with no gauge on it ran dry twice in one afternoon (2026-10-14).
CONFIG_SYS_HEAP_RUNTIME_STATS=y
# dram0 is full (growing the pool past 16 KiB fails to link), but dram1 has
# ~46 KiB spare behind the noinit output section. A .noinit.* section name
# routes the pool there; sys_heap_init formats it, so no zero-init needed.
CONFIG_LV_Z_MEMORY_POOL_ZEPHYR_REGION=y
CONFIG_LV_Z_MEMORY_POOL_ZEPHYR_REGION_NAME=".noinit.lvgl_pool"
# The resistive panel's contact bounce fires a burst of INT edges at touch
# down/up, each producing a full XPT2046 report; a burst can exceed the queue
# within one 10 ms LVGL cycle and drop the button press/release -> missed taps
# (seen on hardware 2026-07-18: a single touch dropped dozens of events).
# The LVGL glue drains the whole msgq every lv_timer_handler pass
# (continue_reading), so a deeper queue only absorbs the burst -- no latency.
# DRAM is nearly full (256 overflowed dram1 by 14 KB, 128 by 2.8 KB): 96 is
# the most that fits, a 50% bump. A driver-level debounce is the real fix if
# this still drops.
CONFIG_INPUT_QUEUE_MAX_MSGS=96
CONFIG_LV_Z_POINTER_INPUT_MSGQ_COUNT=96
# Partial rendering, NOT a 150 KB framebuffer: there is no PSRAM, and
# everything else has to fit in the same 520 KB.
#
# The buffer is 12288 B, not the 6144 this comment used to claim. LV_Z_VDB_SIZE
# is a percentage of the screen, but the Zephyr glue turns it into bytes with
# LV_Z_BITS_PER_PIXEL (modules/lvgl/lvgl.c, BUFFER_SIZE), and that Kconfig lists
# an unconditional `default 32` BEFORE `default 16 if LV_COLOR_DEPTH_16` --
# first default wins, so it is 32 here despite our 16-bit colour.
# 32 * (4 * 320 * 240 / 100) / 8 = 12288, confirmed as .bss.buf0_0 = 0x3000.
#
# Nearly all of it is used: the full byte count goes to lv_display_set_buffers,
# which floors it to whole rows (12288 / 640 B stride = 19 rows), so LVGL renders
# 6080 RGB565 pixels per pass -- 8% of the screen, and ~13 render-and-flush passes
# for a full redraw, not 25. The ~128 B remainder is the row-alignment offcut.
#
# Setting CONFIG_LV_Z_BITS_PER_PIXEL=16 would make the number mean what it says
# and hand ~6 KB back, which is worth remembering: measured 2026-07-26, free
# DRAM is ~3.3 KB in dram0 (__bss_end 0x3ffdf300 vs heap sentry 0x3ffe0000)
# plus ~0.4 KB in dram1. It would also halve the flush chunk and double the
# pass count, so it is a lever for when DRAM gets tight, not a fix.
CONFIG_LV_Z_VDB_SIZE=4
# LVGL's own frame gate. The default 33 ms caps everything at 30 FPS, which is
# irrelevant to a full-screen redraw (124 ms, bounded elsewhere) but does bind
# on the cheap partial redraws, which measure ~5 ms.
#
# 16 does NOT buy a 16 ms period. The repeating lv_timer_handler() call sites
# here sit in loops that sleep between passes -- 10 ms in main.c's mode loops,
# 5 ms in ui_anim.c and in ui_boot's clip playback -- so LVGL
# is never asked to refresh more often than that, and a 16 ms gate lands on
# the first pass that crosses it: ~20 ms either way. Real, but half what the
# number suggests.
#
# It does nothing for the countdown digits: usage_view_tick_1s() is called
# behind a `now - last_tick >= 1000` guard, so that text changes at 1 Hz no
# matter what this is set to.
CONFIG_LV_DEF_REFR_PERIOD=16
CONFIG_LV_USE_ARC=y
CONFIG_LV_USE_SPINNER=y
CONFIG_LV_USE_BUTTON=y
CONFIG_LV_USE_LABEL=y
CONFIG_LV_FONT_MONTSERRAT_20=y
CONFIG_LV_Z_POINTER_INPUT=y

# --- Networking: none ---
#
# The WiFi driver, the IP stack, TLS and the HTTP client used to live here and
# were built into every image. They moved to an opt-in wifi.conf, and that
# went with the standalone WiFi mode on 2026-10-15: the daemon on the
# customer's machine supplies usage, time and firmware, and a radio that is
# never used is still flash, still RAM, and was the OAuth client id and
# refresh token sitting in a shipped binary. git history has both.

# --- Config store, and the bits the display path needs ---
#
# These sat inside the old "Networking" block and moved out with it, which
# broke a USB-only build in ways that had nothing to do with the radio:
# IMG_MANAGER (OTA) depends on FLASH_MAP, and the backlight is a PWM. They
# belong to the board, not to WiFi.
#
# cfg_store is NOT settings/NVS: NVS needs erased flash to read as 0xFF, and
# with flash encryption on, erased sectors read as decrypt-garbage. It keeps
# its own A/B CRC-sealed record in the storage partition instead.
CONFIG_FLASH=y
CONFIG_FLASH_MAP=y
CONFIG_CRC=y
CONFIG_REBOOT=y
CONFIG_PWM=y
CONFIG_ESP_FLASH_ENCRYPTION=y
CONFIG_ZVFS_OPEN_MAX=16
CONFIG_LV_FONT_MONTSERRAT_14=y
CONFIG_LV_FONT_MONTSERRAT_16=y
# Sized for the WiFi build that no longer exists, where the driver and mbedTLS
# shared this pool. A USB-only image has neither and could almost certainly
# run on far less -- worth measuring before trimming, since getting it wrong
# shows up as an allocation failure deep in a driver rather than as a build
# error.
CONFIG_HEAP_MEM_POOL_SIZE=86016

# --- Hashing for the OTA image check ---
#
# NOT a TLS stack -- there is none. ota.c's streamed-image check hashes with
# mbedTLS, and main.c routes mbedTLS's allocator at the kernel heap; both need
# mbedTLS present, neither needs a handshake. A hash brings no client id, no
# certificate and no network.
CONFIG_MBEDTLS=y
CONFIG_MBEDTLS_BUILTIN=y

# --- OTA: image management + slot1 streaming ---
CONFIG_IMG_MANAGER=y
CONFIG_MCUBOOT_BOOTUTIL_LIB=y
CONFIG_STREAM_FLASH=y
CONFIG_IMG_ERASE_PROGRESSIVELY=y
CONFIG_LV_USE_BAR=y
# OTA test boots arm the hardware watchdog: a hard-hung update image stops
# feeding, the chip resets, and MCUboot reverts to the previous version.
CONFIG_WATCHDOG=y
```

## trace.conf
```kconfig
# Touch-trace diagnostic build. Layered on prj.conf via
# -Dfirmware_EXTRA_CONF_FILE=trace.conf; pair with trace.overlay.
CONFIG_BLINK_TOUCH_TRACE=y

# The dump printk()s from the input thread, whose default 1024 B stack is sized
# for callbacks that only forward events.
CONFIG_INPUT_THREAD_STACK_SIZE=2048

# The LVGL pool is NOT shrunk here any more. It used to be, to 27648, when
# dram1_0_seg was ~99% full in a release build and the tracer's 1.5 KB ring
# plus the bigger input stack overflowed it by 612 B. That segment measured
# 66% used with the 40 KB pool in 1.7.1 (64776 of 96 KB), and the settings
# panel alone now needs more than 27648 to draw -- see the pool's note in
# prj.conf -- so a trace build at that size would halt the first time
# settings opened. The trace build inherits the release pool.
```

## src/main.c
```c
#include <zephyr/kernel.h>
#include <zephyr/device.h>
#include <zephyr/drivers/display.h>
#include <zephyr/drivers/mipi_dbi.h>
#include <zephyr/drivers/watchdog.h>
#include <zephyr/dfu/mcuboot.h>
#include <zephyr/random/random.h>
#include <zephyr/sys/reboot.h>
#include <lvgl.h>
#include <mbedtls/platform.h>
#include <string.h>
#include <errno.h>

#include "proto.h"
#include "usage_view.h"
#include "cfg_store.h"
#include "backlight.h"
#include "theme.h"
#include <lvgl_mem.h>
#include "net_time.h"
#include "ui_boot.h"
#include "ui_sleep.h"
#include "sleep_gate.h"
#include "usage_freshness.h"
#include "ui_settings.h"
#include "ui_anim.h"
#include "ota.h"
#include "upd_tap.h"
#include "whatsnew.h"
#include "ui_touchfx.h"
#include "version.h"

static const struct device *const display_dev = DEVICE_DT_GET(DT_CHOSEN(zephyr_display));

/*
 * MADCTL correction for the production batch.
 *
 * These panels differ from the pilot units in two independent ways, and both
 * land in MADCTL (36h), so one write fixes both. Pilot boards must build with
 * CONFIG_BLINK_PANEL_PILOT, which compiles this away entirely.
 *
 * The pilot units and the production panels are driven with byte-identical
 * registers, yet production renders mirrored -- so the difference is in the
 * module, not in anything we send. The usual cure for that, the SS bit in
 * DISCTRL (B6h), was tried on hardware 2026-08-21: the built devicetree
 * carried it (disctrl = [0a a2 27 04]) and the image did not budge, which
 * rules the B6h route out on this controller. MADCTL is honoured, so the
 * compensation lives there instead.
 *
 * It cannot be a devicetree `rotation`. The ili9xxx driver's CMD_SET_1 table
 * reaches only MV (90 deg) and MV|MX|MY (270 deg) in landscape, and those two
 * differ by a pure 180 deg turn -- neither un-mirrors. What this panel needs is
 * MV|MY, which no rotation value can produce. So we re-issue MADCTL ourselves
 * once, straight onto the DBI bus, after the driver has finished its init.
 *
 * Second, the colour order. The driver hardcodes the BGR bit for every
 * orientation, but these panels are wired RGB, so red and blue arrived
 * swapped. Measured 2026-08-21 with a six-bar test pattern of known values:
 * the RED bar read blue and the BLUE bar read red, while GREEN stayed green
 * and white/black were exact -- a clean channel exchange, with no inversion
 * or gamma error. Clearing bit 3 restores it. (Green surviving a red/blue
 * swap untouched is why eyeballing a green UI element misdiagnosed this.)
 *
 * Safe to overwrite: the driver writes MADCTL only from set_orientation(),
 * which runs during init and is never called again (nothing in the LVGL glue
 * touches orientation), so this value is the one that sticks. Partial updates
 * stay correct because MY flips the row-address mapping wholesale -- LVGL's
 * window coordinates and its pixels mirror together, and the panel's own
 * reversed wiring cancels them back out.
 */
#ifdef CONFIG_BLINK_PANEL_PILOT

/* Pilot panels need none of it: the stock rotation=90 MADCTL (BGR|MV) that the
 * driver writes is already correct for them, mirror and colour order alike. */
static void panel_fix_madctl(void)
{
}

#else

#define PANEL_MADCTL_MV   BIT(5)
#define PANEL_MADCTL_MY   BIT(7)

static const struct device *const panel_dbi =
	DEVICE_DT_GET(DT_PARENT(DT_NODELABEL(ili9341)));
static const struct mipi_dbi_config panel_dbi_cfg =
	MIPI_DBI_CONFIG_DT(DT_NODELABEL(ili9341),
			   SPI_OP_MODE_MASTER | SPI_WORD_SET(8), 0);

static void panel_fix_madctl(void)
{
	uint8_t madctl = PANEL_MADCTL_MV | PANEL_MADCTL_MY;	/* BGR bit clear = RGB */
	int r;

	if (!device_is_ready(panel_dbi)) {
		printk("[usage] panel: DBI bus not ready, MADCTL uncorrected\n");
		return;
	}

	r = mipi_dbi_command_write(panel_dbi, &panel_dbi_cfg, 0x36, &madctl, 1);
	if (r < 0) {
		printk("[usage] panel: MADCTL write failed (%d)\n", r);
	} else {
		printk("[usage] panel: MADCTL=0x%02x\n", madctl);
	}
}

#endif /* CONFIG_BLINK_PANEL_PILOT */

/* ---- OTA boot-side: test-boot self-confirm, else MCUboot reverts ---- */

static bool ota_test_boot;
static bool ota_health;		/* the daemon delivered usage to this image */
static int64_t ota_confirm_deadline;
static const struct device *wdt;
static int wdt_chan = -1;

static void ota_boot_begin(void)
{
	if (boot_is_img_confirmed()) {
		return;
	}
	ota_test_boot = true;
	ota_confirm_deadline = k_uptime_get() + 90 * 1000;
	printk("[ota] test boot of %s -- must confirm within 90 s\n",
	       BLINK_FW_VERSION);

	/* Hardware watchdog for hard hangs: a wedged main loop stops feeding,
	 * the chip resets, and MCUboot reverts the unconfirmed image. */
	wdt = DEVICE_DT_GET_OR_NULL(DT_ALIAS(watchdog0));
	if (wdt && device_is_ready(wdt)) {
		struct wdt_timeout_cfg cfg = {
			.window.max = 30000,
			.flags = WDT_FLAG_RESET_SOC,
		};

		wdt_chan = wdt_install_timeout(wdt, &cfg);
		if (wdt_chan >= 0) {
			wdt_setup(wdt, 0);
		}
	}
}

static void ota_boot_pump(void)
{
	if (!ota_test_boot) {
		return;
	}
	if (wdt_chan >= 0) {
		wdt_feed(wdt, wdt_chan);	/* alive != healthy; deadline judges health */
	}
	if (ota_health) {
		boot_write_img_confirmed();
		ota_test_boot = false;
		if (wdt_chan >= 0) {
			wdt_disable(wdt);
			wdt_chan = -1;
		}
		printk("[ota] image confirmed\n");
		return;
	}
	if (k_uptime_get() > ota_confirm_deadline) {
		printk("[ota] not healthy within 90 s -- rebooting to revert\n");
		ui_boot_mark_intentional_reboot();
		sys_reboot(SYS_REBOOT_COLD);
	}
}

/*
 * "Do not close this board's eyes right now", in one place.
 *
 * There were two hand-written copies of this condition and they had already
 * drifted: the doze in run_usb() carried ota_test_boot, and
 * reading_moved_again() -- whose own comment calls it the mirror of that
 * doze -- did not. The drift is unreachable today, because ota_test_boot is
 * raised once in ota_boot_begin() before any mode loop exists and from then
 * on only ever falls. But it is exactly the term whose absence cost a board
 * on the bench (2026-09-03): dozing blocks the loop that feeds the 30 s
 * watchdog an unconfirmed image arms, the SoC resets, MCUboot re-runs the
 * same unconfirmed image, and it dozes again at 60 s -- forever. A condition
 * that has to be right in two files to keep a board out of a reset loop
 * should exist once.
 *
 * "An update is in flight" honestly covers "the new image has not proved
 * itself yet", which is why the test boot rides this term instead of
 * becoming a fourth condition at each call site; staying awake is also what
 * lets the deliberate revert at the 90 s deadline happen, logged, rather
 * than as a bare watchdog reset nobody can read afterwards.
 *
 * Read fresh on every call, never cached: an update that starts while the
 * board is already dozing has to put the progress screen back up.
 */
static bool ota_blocks_sleep(void)
{
	struct ota_ui snap;

	ota_ui_get(&snap);
	return snap.st == OTA_UI_DOWNLOADING || snap.st == OTA_UI_REBOOTING ||
	       ota_test_boot;
}

/* Did the previous boot's install land? Runs once the gauge screen exists so
 * the notice popup has somewhere to live. */
static void ota_report_outcome(void)
{
	char trail[CFG_OTA_VER_MAX];
	char from[CFG_OTA_VER_MAX], to[CFG_OTA_VER_MAX];
	char summary[WHATSNEW_SUMMARY_MAX];

	if (cfg_get_ota_state(trail, sizeof(trail)) != 1) {
		return;
	}
	cfg_set_ota_state(0, "");
	/* Through whatsnew_split, always: the breadcrumb may be a packed
	 * pair, and comparing "1.2.5>1.3.2" against BLINK_FW_VERSION would
	 * announce a successful update as a failed one. */
	whatsnew_split(trail, from, sizeof(from), to, sizeof(to));
	/*
	 * The board's own verdict on the update, in the console log.
	 *
	 * It had none. The daemon logs that it flashed an image and the panel
	 * puts up a popup that is gone as soon as anyone taps OK, so the one
	 * question support actually asks after a failed update -- did the
	 * board come up on the version it was aiming at -- had no answer
	 * anywhere afterwards.
	 *
	 * It also makes this decision observable on a bench. That matters
	 * more than it looks: reading the breadcrumb wrongly reports a
	 * SUCCESSFUL update as a failure, silently, and the popup it puts up
	 * is the only other evidence.
	 */
	printk("[ota] update %s: wanted %s, running %s (from %s)\n",
	       strcmp(to, BLINK_FW_VERSION) == 0 ? "landed" : "REVERTED",
	       to, BLINK_FW_VERSION, from[0] ? from : "?");
	if (strcmp(to, BLINK_FW_VERSION) == 0) {
		/*
		 * The notice says how much changed; the screen behind it says
		 * what. An empty summary means this release has no entry in
		 * the table, and then the notice shows the tick and the
		 * version alone rather than offering a screen with nothing
		 * on it.
		 */
		whatsnew_summary(from, BLINK_FW_VERSION, summary,
				 sizeof(summary));
		ui_settings_notice_update(BLINK_FW_VERSION, summary, from,
					  BLINK_FW_VERSION);
	} else {
		ui_settings_notice("Update failed, previous version restored.");
	}
}

/* The CONNECTING bar's steps, as the tethered path shows them. */
static const char *const usb_boot_steps[] = {
	"Link the PC daemon",
	"Fetch first usage",
};

static void usb_anim_pump(void)
{
	proto_service();
	if (usage_view_have_data()) {
		ota_health = true;	/* daemon delivered usage */
	}
	ota_boot_pump();
}


/* ---- USB bridge mode: PC daemon pushes usage over serial ---- */

/* The original reason to wake: the app said something. proto.c clears
 * host_seen on the timeout that armed the sleep in the first place, so this
 * is false throughout the doze and true on the first line back. */
static bool host_is_back(void)
{
	return proto_host_seen();
}

/*
 * The other reason to wake: something new to show.
 *
 * The mirror of sleep_stale_should_start's non-had_usage terms, and it has
 * to be exactly that -- tests/sleep_gate pins the two as complements over a
 * grid, because a wake condition a second away from the sleep condition
 * would have this board closing and opening its eyes forever on a real desk.
 *
 * It says mirror and now it is one: the OTA term comes from
 * ota_blocks_sleep(), the same call the doze arms on. It used to be spelled
 * out here a second time, and the second spelling was missing ota_test_boot.
 */
static bool reading_moved_again(void)
{
	/* The ACTIVE age, matching the branch that started this doze. Waking
	 * on the reading age instead would break the complementarity the grid
	 * in tests/sleep_gate pins, on exactly the desk this field exists
	 * for: a remembered reading never gets younger, so the board would
	 * doze on one number and refuse to wake on the other. */
	int32_t active_age = usage_freshness_active_age_s(k_uptime_get());

	return sleep_stale_should_wake(active_age, ota_blocks_sleep(),
				       usage_freshness_activity());
}

static void run_usb(void)
{
	int64_t last_tick = k_uptime_get();
	int stage_shown = 1;

	/* When the app was last heard from, for the waiting-for-host doze
	 * below. Starts at the top of the loop rather than at boot: this is
	 * about how long THIS screen has been unanswered. */
	int64_t host_quiet_since = last_tick;
	int64_t checking_since = 0;	/* OTA_UI_CHECKING entered at, ms */

	/* Drop anything latched before this loop existed to service it. See
	 * ui_settings.h. */
	ui_settings_drop_pending();
	{
		/* The pool as the gauge screen leaves it, once per boot: the
		 * baseline every other screen stacks on. See ui_badges.c. */
		struct sys_memory_stats st;

		lvgl_heap_stats(&st);
		printk("[mem] lvgl pool at the gauges: %u used, %u free, peak %u\n",
		       (unsigned)st.allocated_bytes, (unsigned)st.free_bytes,
		       (unsigned)st.max_allocated_bytes);
	}
	if (theme_take_reopen()) {
		ui_settings_reopen_display();	/* a contrast change brought us here */
	}

	while (1) {
		proto_service();

		if (usage_view_have_data()) {
			ota_health = true;	/* daemon delivered usage */
		}
		ota_boot_pump();

		/* Two reasons to doze (docs/sleep-mode-design.md). The first
		 * is silence past the host timeout. The second is an app that
		 * never stopped talking and has had nothing new to say for
		 * hours -- which is what a sleeping computer with a running
		 * daemon actually looks like from here, and why the first
		 * rule alone left a panel awake all night (field report
		 * 2026-09-02). Both block until there is a reason to wake.
		 *
		 * And neither of them while the owner is in the settings
		 * panel.
		 *
		 * Both rules below are about an absent person, and an open
		 * panel is a present one -- the same argument sleep_gate.c
		 * makes for refusing to doze over anything on screen that is
		 * asking for somebody. It also closes the loop ui_sleep.c
		 * opens at the other end: a swipe during a peek ends the
		 * doze, this loop opens the panel on its next pass, and
		 * without this the board would fall asleep again over the
		 * open panel sixty seconds later -- with the owner reading
		 * it. The cost is that a panel left open holds the board
		 * awake indefinitely; that is a deliberate act by a person
		 * standing at the desk, and it ends when they close it.
		 */
		if (!ui_settings_busy()) {
			/* Whether an update forbids dozing is one question
			 * with one answer, and it lives at
			 * ota_blocks_sleep() -- including the test-boot term,
			 * whose absence from the copy that used to sit here
			 * cost a board on the bench (2026-09-03). Taken once
			 * so both rules below judge the same instant. */
			bool ota_busy = ota_blocks_sleep();

			if (sleep_should_start(proto_host_lost(),
					       usage_view_have_data(),
					       ota_busy)) {
				ui_sleep_run(host_is_back,
					     "Your computer may be asleep.");
				continue;
			}
			/*
			 * On the ACTIVE age, never the reading's own.
			 *
			 * "Has this number stopped moving?" and "has this
			 * desk gone quiet?" are two questions, and the
			 * daemon answers both because they can differ: it
			 * re-offers the last five-hour reading it saw at its
			 * original time, so the dial can be twelve hours old
			 * five seconds after Claude Code rewrote the file it
			 * came from. Dozing on the first question closed the
			 * board's eyes on an owner who was sitting in front
			 * of it (field review 2026-09-02). ui_sleep.c's
			 * closing stamp keeps asking the first question,
			 * because that one really is about the number.
			 */
			if (sleep_stale_should_start(
				    usage_freshness_active_age_s(
					    k_uptime_get()),
				    usage_view_have_data(), ota_busy,
				    usage_freshness_activity())) {
				ui_sleep_run(reading_moved_again,
					     "No new readings for a while.");
				continue;
			}
		}

		/*
		 * OTA, via the daemon. This mode has no network of its own --
		 * nothing here starts net_worker -- so ota_check()/ota_install()
		 * cannot run and the update row used to do nothing at all when
		 * tethered (user-reported 2026-08-20). The daemon has both an
		 * internet connection and this link, so it does the fetching and
		 * pushes the image down; see the OTA block in proto.c.
		 *
		 * Gated on the daemon TALKING, not on it having delivered
		 * usage. Those are unrelated: the usage endpoint is
		 * aggressively rate-limited (the bridge backs off 120-600 s on
		 * a 429), and gating here on ota_health meant a throttled
		 * session never checked for updates at all -- observed
		 * 2026-08-21. The board needs no clock and no token of its
		 * own for this: the daemon does the fetching.
		 */
		/* The boot-time check moved into proto.c's welcome handler,
		 * which fires on every host connection rather than the first;
		 * see there. */
		/*
		 * Both flags are taken unconditionally, before either is acted
		 * on. They are consume-on-read, so reading one only when the
		 * other is clear leaves a stale request armed for the next
		 * turn -- and reading them inside the call would leave the
		 * order to the compiler. upd_tap.h has the rule and the bug
		 * that produced it: a customer's tap on "Update now" during a
		 * daemon restart went nowhere at all.
		 */
		{
			bool inst_req = ota_take_install_request();
			bool chk_req = ota_take_check_request();

			switch (upd_tap_act(inst_req, chk_req,
					    proto_ota_staged())) {
			case UPD_ACT_CHECK:
				proto_ota_check();
				break;
			case UPD_ACT_INSTALL:
				proto_ota_install();
				break;
			case UPD_ACT_REFUSED:
				/* Consent with nothing to spend it on. Say so
				 * here rather than let the 30 s watchdog below
				 * describe it as a failed check: the customer
				 * asked to install, and an answer about
				 * checking sends them somewhere else. */
				ota_ui_set(OTA_UI_FAILED, NULL, 0);
				ota_ui_set_error("The app stopped answering");
				break;
			case UPD_ACT_NONE:
				break;
			}
		}
		/*
		 * A check nobody answers must not hang the row. The query goes
		 * out over the cable; if the daemon was restarting at that
		 * moment (an app update does exactly that) it was never read,
		 * and "Checking..." with the row disabled stayed on screen
		 * for good (user-reported 2026-08-29). Thirty seconds is far
		 * past a feed fetch; after it the row says why and a tap
		 * asks again.
		 */
		{
			struct ota_ui snap;

			ota_ui_get(&snap);
			if (snap.st == OTA_UI_CHECKING) {
				if (checking_since == 0) {
					checking_since = k_uptime_get();
				} else if (k_uptime_get() - checking_since
					   > 30 * 1000) {
					ota_ui_set(OTA_UI_FAILED, NULL, 0);
					ota_ui_set_error("No answer from the app");
					checking_since = 0;
				}
			} else {
				checking_since = 0;
			}
		}
		/* No completion handling: the daemon writes slot0 with esptool
		 * and resets the board itself, so the next thing that happens
		 * here is a boot. See the OTA block in proto.c.
		 */

		if (ui_anim_pending()) {
			ui_anim_run(usb_anim_pump);
		}
		ui_settings_service(usb_anim_pump);

		if (!usage_view_have_data()) {
			/* Keep the bar honest: hello was answered at boot,
			 * but proto declares the host gone after 35 s of
			 * silence -- drop back to the link step then. */
			int want = proto_host_seen() ? 1 : 0;

			if (want != stage_shown) {
				usage_view_boot_stage(want);
				stage_shown = want;
			}

			/*
			 * Waiting-for-host timeout.
			 *
			 * This used to cold-reboot into standalone
			 * (user request 2026-07-16), on the theory that a
			 * daemon which has not spoken is not coming back and
			 * a board with WiFi and a token can serve itself. On
			 * a desk it read as an unexplained reset, and it made
			 * the two never-heard-from-a-daemon cases behave
			 * differently for no reason a user could see: a board
			 * that once talked to the app dozes, a board that
			 * never did rebooted. Now both doze (owner's call,
			 * 2026-09-02). The standalone WiFi mode it rebooted
			 * into was removed altogether on 2026-10-15.
			 *
			 * Still gated on the host being GONE rather than
			 * slow, which is what stops a live-but-busy daemon
			 * from dozing us mid-conversation -- and note that
			 * proto_host_seen() goes false again after
			 * HOST_TIMEOUT_MS, so the timer restarts on every
			 * silence rather than only the first.
			 */
			if (proto_host_seen()) {
				host_quiet_since = k_uptime_get();
			} else if (!ota_blocks_sleep() &&
				   !ui_settings_busy() &&
				   k_uptime_get() - host_quiet_since
				   > 60 * 1000) {
				/* Both refusals are the ones argued at the
				 * doze block above, and this is the branch
				 * they matter most in. It is the one that
				 * was found looping on the watchdog -- this
				 * loop feeds the unconfirmed image's, and a
				 * board with no daemon is exactly the board
				 * whose image cannot prove itself, so the
				 * two conditions coincide precisely here.
				 * And it is the one an owner meets when the
				 * app is not installed: this is the doze
				 * they swipe out of to reach settings, so
				 * dozing again while they are in there would
				 * shut the door behind them. The timer keeps
				 * running, so the doze happens the moment
				 * either reason clears. */
				printk("[usage] no app after 60 s; dozing until one speaks\n");
				ui_sleep_run(host_is_back,
					     "Waiting for the app on your computer.");
				host_quiet_since = k_uptime_get();
				continue;
			}
		}

		int64_t now = k_uptime_get();

		if (now - last_tick >= 1000) {
			usage_view_tick_1s();
			last_tick = now;

			int hh = -1, mm = 0;

			net_time_local(&hh, &mm);
			usage_view_set_clock(hh, mm);
		}
		lv_timer_handler();
		k_sleep(K_MSEC(10));
	}
}

int main(void)
{
	printk("[usage] firmware boot OK\n");

	/* Route mbedTLS at the kernel heap. MBEDTLS_ENABLE_HEAP is off, so
	 * without this it falls back to libc calloc, and picolibc's heap here
	 * is ~5 KB. Nothing in this build runs TLS -- the handshakes and the
	 * 16 KB record buffer this was written for belonged to the WiFi mode
	 * removed on 2026-10-15 -- but mbedTLS is still linked (ota.c), and it
	 * stays pointed at a heap that can hold it. k_calloc/k_free match
	 * mbedTLS's expected signatures exactly. */
	if (mbedtls_platform_set_calloc_free(k_calloc, k_free) != 0) {
		printk("[usage] FATAL: mbedTLS allocator hookup failed\n");
		return -1;
	}

	if (!device_is_ready(display_dev)) {
		printk("[usage] display not ready\n");
		return -1;
	}
	panel_fix_madctl();
	display_blanking_off(display_dev);
	ui_touchfx_init();	/* light touch-echo feedback on every press */

	cfg_init();
	theme_init();	/* before any screen is built: they take its colours */
	usage_view_set_egg_cb(proto_send_egg);	/* the wordmark taps, see ui_badges.c */
	ota_boot_begin();	/* unconfirmed image? start the confirm clock */
	/* ...and from here the boot screen's own wait loops feed it too; they
	 * block for seconds against a 30 s window. */
	ui_boot_set_pump(ota_boot_pump);
	backlight_init();	/* drive the PWM to the persisted level */
	/* Nothing in this firmware can use a refresh token -- the OAuth code
	 * is gone. But a unit that once ran a WiFi build still has one in its
	 * config record, and unfused flash is readable over USB with esptool,
	 * so removing the writer does not make the customer's token go away.
	 * Erase it on the first boot that cannot use it. */
	{
		char tok[CFG_TOKEN_MAX];

		if (cfg_get_token(tok, sizeof(tok))) {
			cfg_clear_token();
			printk("[usage] cleared a stored refresh token: no WiFi in this build\n");
		}
	}

	/* proto first: its hello goes out now, so a daemon's reply is already
	 * in flight during the splash and the selection can short-circuit. */
	proto_init();

	ui_boot_splash();

	/* Did a daemon speak during the splash? Plugging into a PC later still
	 * works -- the daemon opening the port resets this board, so it always
	 * announces itself into a fresh splash. */
	if (proto_host_seen()) {
		printk("[usage] mode: USB bridge\n");
		usage_view_init();
		/* The link step is already done -- the daemon spoke during the
		 * splash. */
		usage_view_boot_begin(usb_boot_steps, 2);
		usage_view_boot_stage(1);
		lv_timer_handler();
		ui_boot_teardown();	/* only after the new screen is loaded */
		ui_settings_attach(lv_scr_act());
		ota_report_outcome();
		usage_view_set_status(USAGE_STATUS_DISCONNECTED);
		proto_resync();		/* daemon re-pushes time+usage right away */
		run_usb();
	}

	/*
	 * No daemon yet, and no radio to fall back on. run_usb() owns this case
	 * too: it shows the waiting-for-host step and times out on its own if
	 * no daemon ever speaks. Deliberately no proto_resync() here -- that
	 * exists to make a daemon that already said hello re-push, and by
	 * definition none has.
	 */
	printk("[usage] mode: USB bridge (no host yet)\n");
	usage_view_init();
	usage_view_boot_begin(usb_boot_steps, 2);
	lv_timer_handler();
	ui_boot_teardown();
	ui_settings_attach(lv_scr_act());
	ota_report_outcome();
	usage_view_set_status(USAGE_STATUS_DISCONNECTED);
	run_usb();
	return 0;
}
```

## src/badges.c
```c
/*
 * The badge table and the collection the board holds -- see badges.h.
 *
 * Pure C with no LVGL and no Zephyr in it, so tests/badges can check every
 * sentence the screen will show. The icons are LVGL's FontAwesome symbols,
 * spelled as their UTF-8 bytes so this file does not need lvgl.h to name
 * them; ui_badges.c draws them in the montserrat fonts, which carry that
 * range.
 *
 * Every sentence is sentence case, and each fits the detail line's 47
 * characters (CLAUDE.md) -- tests/badges checks both.
 */
#include <stdio.h>
#include <string.h>

#include "badges.h"

/* LV_SYMBOL_* as their UTF-8, so this file stays free of lvgl.h. */
#define SYM_EYE_OPEN	"\xEF\x81\xAE"
#define SYM_EYE_CLOSE	"\xEF\x81\xB0"
#define SYM_UP		"\xEF\x81\xB7"
#define SYM_LIST	"\xEF\x80\x8B"
#define SYM_SHUFFLE	"\xEF\x81\xB4"
#define SYM_LOOP	"\xEF\x81\xB9"
#define SYM_CHARGE	"\xEF\x83\xA7"
#define SYM_BELL	"\xEF\x83\xB3"
#define SYM_TINT	"\xEF\x81\x83"
#define SYM_OK		"\xEF\x80\x8C"
#define SYM_BATTERY	"\xEF\x89\x80"
#define SYM_GPS		"\xEF\x84\xA4"
#define SYM_BARS	"\xEF\x83\x89"
#define SYM_SETTINGS	"\xEF\x80\x93"

static const struct badge table[BADGE_COUNT] = {
	{ "First Light", "Your first live reading on the board",
	  SYM_EYE_OPEN, BADGE_TIER_NORMAL },
	{ "Early Bird", "A session running between 4 and 6 am",
	  SYM_UP, BADGE_TIER_NORMAL },
	{ "Night Owl", "A session running between midnight and 4 am",
	  SYM_EYE_CLOSE, BADGE_TIER_NORMAL },
	{ "Multitasker", "Three sessions running at once",
	  SYM_LIST, BADGE_TIER_NORMAL },
	{ "Agent Wrangler", "Five subagents running at once",
	  SYM_SHUFFLE, BADGE_TIER_NORMAL },
	{ "Polyglot", "Claude and Codex both used in one day",
	  SYM_LOOP, BADGE_TIER_NORMAL },
	{ "Week Streak", "Claude used seven days in a row",
	  SYM_CHARGE, BADGE_TIER_NORMAL },
	{ "Quick Draw", "Answer a waiting session in 10 s, 10 times",
	  SYM_BELL, BADGE_TIER_NORMAL },
	{ "Cool Head", "A week reset with under half of it used",
	  SYM_TINT, BADGE_TIER_NORMAL },
	{ "Centurion", "A hundred sessions finished",
	  SYM_OK, BADGE_TIER_NORMAL },
	{ "Iron Streak", "Claude used thirty days in a row",
	  SYM_BATTERY, BADGE_TIER_HARD },
	{ "Bullseye", "A week closed at 95% or more, never over",
	  SYM_GPS, BADGE_TIER_HARD },
	{ "Swarm Lord", "Four sessions and ten subagents at once",
	  SYM_BARS, BADGE_TIER_HARD },
	{ "Blacksmith", "You found the forge",
	  SYM_SETTINGS, BADGE_TIER_SECRET },
	{ "Don't Panic", "A gauge stopped at exactly 42%",
	  "42", BADGE_TIER_SECRET },
};

static uint32_t got;

const struct badge *badge_get(int i)
{
	return (i >= 0 && i < BADGE_COUNT) ? &table[i] : NULL;
}

void badges_set_mask(uint32_t mask)
{
	/* Bits past the table are badges from a newer daemon. Kept, so a
	 * later firmware that knows them finds them; never drawn here. */
	got = mask;
}

uint32_t badges_mask(void)
{
	return got;
}

bool badge_earned(int i)
{
	return i >= 0 && i < BADGE_COUNT && (got & (1u << i)) != 0;
}

int badges_earned_count(void)
{
	int n = 0;

	for (int i = 0; i < BADGE_COUNT; i++) {
		n += badge_earned(i) ? 1 : 0;
	}
	return n;
}

const char *badge_title(int i)
{
	const struct badge *b = badge_get(i);

	if (b == NULL) {
		return "";
	}
	if (b->tier == BADGE_TIER_SECRET && !badge_earned(i)) {
		return "???";
	}
	return b->name;
}

const char *badge_detail(int i)
{
	const struct badge *b = badge_get(i);

	if (b == NULL) {
		return "";
	}
	if (b->tier == BADGE_TIER_SECRET && !badge_earned(i)) {
		return "Hidden. Keep exploring.";
	}
	return b->how;
}

void badge_announcement(int i, char *buf, size_t len)
{
	const struct badge *b = badge_get(i);

	if (buf == NULL || len == 0) {
		return;
	}
	snprintf(buf, len, "Badge earned: %s", b ? b->name : "?");
}

void badges_summary(char *buf, size_t len)
{
	if (buf == NULL || len == 0) {
		return;
	}
	snprintf(buf, len, "%d of %d", badges_earned_count(), BADGE_COUNT);
}
```

## src/badges.h
```c
#ifndef BADGES_H
#define BADGES_H

#include <stdbool.h>
#include <stddef.h>
#include <stdint.h>

/*
 * Badges: goals met while using the board (pc/badges.py, where the rules
 * live). The board holds the words and the collection it was last sent;
 * the daemon decides what has been earned.
 *
 * INDEX N HERE IS BIT N ON THE WIRE, and is badge N in pc/badges.BADGES --
 * tests/pc/test_badges.py reads this file's table and checks the names
 * line up. Never reorder; add at the end.
 */
#define BADGE_COUNT 15

enum badge_tier {
	BADGE_TIER_NORMAL,	/* the ten everyday ones */
	BADGE_TIER_HARD,	/* the three that take weeks */
	BADGE_TIER_SECRET,	/* hidden until found: "???" */
};

struct badge {
	const char *name;	/* "Night Owl" */
	const char *how;	/* one sentence, what earns it */
	const char *icon;	/* an LV_SYMBOL glyph, or a short text */
	enum badge_tier tier;
};

const struct badge *badge_get(int i);

/* The collection, as last sent by the daemon (protocol `badges`). */
void badges_set_mask(uint32_t mask);
uint32_t badges_mask(void);
bool badge_earned(int i);
int badges_earned_count(void);

/* "Night Owl", or "???" for a hidden badge not yet found. */
const char *badge_title(int i);

/* What the detail line under the grid says for badge i: the earning rule,
 * or a nudge for a hidden one not yet found. */
const char *badge_detail(int i);

/* "Badge earned: Night Owl" -- the card the gauges show. Always the real
 * name: by the time it is announced, it has been found. */
void badge_announcement(int i, char *buf, size_t len);

/* "7 of 15" -- the settings row's subtitle. */
void badges_summary(char *buf, size_t len);

#endif /* BADGES_H */
```

## src/cfg_store.h
```c
#ifndef CFG_STORE_H
#define CFG_STORE_H

#include <stddef.h>
#include <stdbool.h>
#include <stdint.h>

/* Where the board gets its numbers from. Persisted, so the choice survives a
 * power cycle -- being asked again on every boot would make it a worse device.
 */
enum cfg_mode {
	CFG_MODE_UNSET = 0,
	CFG_MODE_USB,		/* PC daemon pushes usage over serial */
	CFG_MODE_WIFI,		/* board fetches usage itself */
};

#define CFG_SSID_MAX 33		/* 32 + NUL */
#define CFG_PSK_MAX 65		/* 64 + NUL */
#define CFG_TOKEN_MAX 320	/* OAuth refresh tokens are long */

int cfg_init(void);

enum cfg_mode cfg_get_mode(void);
int cfg_set_mode(enum cfg_mode mode);

/* WiFi credentials. cfg_get_wifi() returns false if none are stored. */
bool cfg_get_wifi(char *ssid, size_t ssid_len, char *psk, size_t psk_len);
int cfg_set_wifi(const char *ssid, const char *psk);

/*
 * The OAuth refresh token.
 *
 * Stored separately from the WiFi credentials on purpose: when the token is
 * rejected and the user has to sign in again, we clear ONLY the token and keep
 * them on their network -- one pasted code, not a full re-provision.
 *
 * Secret. Never logged.
 */
bool cfg_get_token(char *tok, size_t len);
int cfg_set_token(const char *tok);
int cfg_clear_token(void);

/* Clear ONLY the WiFi credentials (settings-screen "Reset WiFi"): the token
 * survives, so after re-provisioning the network the gauges come back without
 * another sign-in. */
int cfg_clear_wifi(void);

#define CFG_AP_PSK_MAX 17	/* 16 + NUL; generated ones are 10 chars */

/* The setup AP's WPA2 password: random, generated once at first boot and
 * stable thereafter, so a printed/remembered QR keeps working. Rides in the
 * join QR, never typed. cfg_get_ap_psk() returns false until one is stored.
 * Cleared only by factory reset (a new one is generated on the next boot). */
bool cfg_get_ap_psk(char *psk, size_t len);
int cfg_set_ap_psk(const char *psk);

/* Which window the weekly gauge shows (0 = all models, 1 = fable): the
 * peek-card choice, persisted so a reboot keeps it. Defaults to 0. */
uint8_t cfg_get_weekly_sel(void);
int cfg_set_weekly_sel(uint8_t sel);

/*
 * Which provider the panel treats as primary -- the outer ring, the big
 * number, the first countdown.
 *
 * Kept on the DEVICE rather than in the daemon because it is the device the
 * user is looking at when they decide, and because a preference that resets
 * every time the daemon restarts is not a preference. The board announces it
 * to the host, which is what actually acts on it.
 */
enum cfg_main_src {
	CFG_MAIN_SRC_CLAUDE = 0,	/* also the value an unset record reads as */
	CFG_MAIN_SRC_CODEX = 1,
};

uint8_t cfg_get_main_src(void);
int cfg_set_main_src(uint8_t src);

/* Screen brightness percent, one of 20/40/60/80/100. Persisted so a reboot
 * keeps it. Returns 100 when never set (a fresh or pre-update device). */
uint8_t cfg_get_bright_pct(void);
int cfg_set_bright_pct(uint8_t pct);

/* Screen contrast level, 0 = normal (see theme.h). Persisted like the
 * brightness. Returns 0 when never set. Not range-checked here: theme.c
 * clamps what it reads. */
uint8_t cfg_get_contrast(void);
int cfg_set_contrast(uint8_t level);

/* Last known UTC offset (minutes east of UTC), fed by the tz API in WiFi mode
 * so the clock survives API outages. cfg_get_tz() returns false until an
 * offset has ever been stored. */
bool cfg_get_tz(int32_t *offset_min);
int cfg_set_tz(int32_t offset_min);

#define CFG_OTA_VER_MAX 16	/* "MAJOR.MINOR.PATCH" + NUL, with headroom */

/* OTA handshake across the update reboot: state 1 + target version are
 * written just before rebooting into a new image; the next boot compares the
 * running version to the target to report success or revert. */
uint8_t cfg_get_ota_state(char *ver, size_t len);
int cfg_set_ota_state(uint8_t st, const char *ver);

/* Wipe everything (factory reset). */
int cfg_reset(void);


/*
 * Which edition this unit is: which boot clip it plays.
 *
 * A FACTORY fact, not a preference. It is written once over USB after the
 * board is programmed (`blink provision --edition codex`) and there is
 * deliberately no way to reach it from the settings screen -- the enclosure
 * decides it, and a user who could flip it would only be putting the wrong
 * animation in the wrong box.
 *
 * Living on the unit rather than in the binary is what keeps ONE firmware
 * image for both editions. The alternative was a second build, which forks
 * the OTA feed: the manifest names one firmware and `hello` carries no
 * edition, so a Codex unit would be offered the Claude image and would take
 * it -- its identity reverting silently, in the field, months later. Both
 * clips are compiled in instead and this picks between them at boot. The
 * second one costs 17 KB on an image using 663 KB of 4 MB.
 *
 * 0 is Claude, so an unset record -- every unit built before this existed --
 * reads as the edition that was already shipping.
 *
 * WRITE ONCE. The first successful cfg_set_edition() latches the record, and
 * every later one is refused with -EPERM. "No way to reach it from the
 * settings screen" was not enough: the message that stamps it arrives over
 * USB from whatever is on the other end of the cable, and the CLI that sends
 * it is the same binary the user installs. Without the latch, anyone who owns
 * a unit owns `blink provision`, and the enclosure and the animation inside
 * it stop agreeing.
 *
 * The latch also survives cfg_reset(). A factory reset wipes what the USER
 * put on the device -- network, token, preferences -- and the edition is not
 * that. It is a property of the box the board is screwed into, and a reset
 * that cleared it would be a second route to the same change, reachable from
 * the settings menu with no computer involved at all.
 *
 * What remains is erasing the config partition with esptool over USB, with
 * the board held in bootloader mode. That is a factory operation by
 * construction, which is the boundary that was wanted.
 */
enum cfg_edition {
	CFG_EDITION_CLAUDE = 0,
	CFG_EDITION_CODEX = 1,
};

uint8_t cfg_get_edition(void);

/* Whether this unit has already been stamped. Provisioning tools ask first so
 * they can say "already a codex unit" instead of reporting a bare failure. */
bool cfg_edition_locked(void);

/*
 * Stamp the edition. Returns -EPERM if this unit was already stamped, and
 * -EINVAL for an edition this firmware does not know.
 */
int cfg_set_edition(uint8_t edition);

#endif /* CFG_STORE_H */
```
